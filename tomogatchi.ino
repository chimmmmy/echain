#include <bluefruit.h>
#include <GxEPD2_BW.h>

#define CS_PIN   D1
#define DC_PIN   D3
#define RST_PIN  D0
#define BUSY_PIN D5
#define BUTTON_PIN D6

GxEPD2_BW<GxEPD2_290_T94_V2, GxEPD2_290_T94_V2::HEIGHT> display(
    GxEPD2_290_T94_V2(CS_PIN, DC_PIN, RST_PIN, BUSY_PIN));

// BLE
BLEService musicService("12345678-1234-1234-1234-123456789abc");
BLECharacteristic titleChar("12345678-1234-1234-1234-123456789001", BLEWrite, 64);
BLECharacteristic artistChar("12345678-1234-1234-1234-123456789002", BLEWrite, 64);
BLECharacteristic albumChar("12345678-1234-1234-1234-123456789003", BLEWrite, 64);

char songTitle[64]  = "SONG NAME";
char artistName[64] = "ARTIST NAME";
char albumName[64]  = "ALBUM TITLE";
bool musicUpdated   = false;

// Bitmaps - Scene 0 (Home)
static const unsigned char PROGMEM image__02e0dfdb9faa21e2d2c615f8d9a0a1b7_bits[] = {0x00,0x00,0x00,0x00,0x00,0x00,0x00,0x00,0x00,0x00,0x00,0x00,0x00,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0x00,0x00};
static const unsigned char PROGMEM image_arrow_right_bits[] = {0x00,0xc0,0x00,0xc0,0x00,0x30,0x00,0x30,0xff,0xfc,0xff,0xfc,0x00,0x30,0x00,0x30,0x00,0xc0,0x00,0xc0};
static const unsigned char PROGMEM image_battery_empty_bits[] = {0x00,0x00,0x00,0x0f,0xff,0xfe,0x10,0x00,0x01,0x10,0x00,0x01,0x70,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0x00,0x00};
static const unsigned char PROGMEM image_bluetooth_bits[] = {0x01,0x00,0x02,0x80,0x02,0x40,0x22,0x20,0x12,0x20,0x0a,0x40,0x06,0x80,0x03,0x00,0x06,0x80,0x0a,0x40,0x12,0x20,0x22,0x20,0x02,0x40,0x02,0x80,0x01,0x00,0x00,0x00};
static const unsigned char PROGMEM image_device_power_button_bits[] = {0x01,0x00,0x01,0x00,0x19,0x30,0x25,0x48,0x49,0x24,0x51,0x14,0xa1,0x0a,0xa0,0x0a,0xa0,0x0a,0xa0,0x0a,0xa0,0x0a,0x50,0x14,0x48,0x24,0x27,0xc8,0x18,0x30,0x07,0xc0};
static const unsigned char PROGMEM image_Layer_9_bits[] = {0xf0,0xf0,0x3c,0x3c,0x0f,0x0f,0x03,0x03};

// Bitmaps - Scene 1 (Music)
static const unsigned char PROGMEM image_arrow_left_bits[] = {0x0c,0x00,0x0c,0x00,0x30,0x00,0x30,0x00,0xff,0xfc,0xff,0xfc,0x30,0x00,0x30,0x00,0x0c,0x00,0x0c,0x00};
static const unsigned char PROGMEM image_music_next_bits[] = {0x00,0x00,0xe0,0x0f,0x90,0x09,0x8c,0x09,0x82,0x09,0x81,0x89,0x80,0x49,0x80,0x39,0x80,0x39,0x80,0x49,0x81,0x89,0x82,0x09,0x8c,0x09,0x90,0x09,0xe0,0x0f,0x00,0x00};
static const unsigned char PROGMEM image_music_play_bits[] = {0xc0,0x00,0xe0,0x00,0x98,0x00,0x86,0x00,0x81,0x80,0x80,0x60,0x80,0x18,0x80,0x06,0x80,0x18,0x80,0x60,0x81,0x80,0x86,0x00,0x98,0x00,0xe0,0x00,0xc0,0x00,0x00,0x00};
static const unsigned char PROGMEM image_music_previous_bits[] = {0x00,0x00,0xf0,0x07,0x90,0x09,0x90,0x31,0x90,0x41,0x91,0x81,0x92,0x01,0x9c,0x01,0x9c,0x01,0x92,0x01,0x91,0x81,0x90,0x41,0x90,0x31,0x90,0x09,0xf0,0x07,0x00,0x00};

int currentScene = 0;
bool lastButtonState = HIGH;

void titleWriteCallback(uint16_t conn_handle, BLECharacteristic* chr, uint8_t* data, uint16_t len) {
  memset(songTitle, 0, sizeof(songTitle));
  memcpy(songTitle, data, min((int)len, 63));
  musicUpdated = true;
}

void artistWriteCallback(uint16_t conn_handle, BLECharacteristic* chr, uint8_t* data, uint16_t len) {
  memset(artistName, 0, sizeof(artistName));
  memcpy(artistName, data, min((int)len, 63));
  musicUpdated = true;
}

void albumWriteCallback(uint16_t conn_handle, BLECharacteristic* chr, uint8_t* data, uint16_t len) {
  memset(albumName, 0, sizeof(albumName));
  memcpy(albumName, data, min((int)len, 63));
  musicUpdated = true;
}

void drawScene0() {
  display.setFullWindow();
  display.firstPage();
  do {
    display.fillScreen(GxEPD_WHITE);
    display.drawBitmap(265, 4,  image_battery_empty_bits,                     24, 16, GxEPD_BLACK);
    display.drawBitmap(7,   4,  image_bluetooth_bits,                          14, 16, GxEPD_BLACK);
    display.setFont();
    display.setTextColor(GxEPD_BLACK);
    display.setCursor(136, 6);
    display.print("home");
    display.drawBitmap(135, 42, image__02e0dfdb9faa21e2d2c615f8d9a0a1b7_bits, 58, 64, GxEPD_BLACK);
    display.drawBitmap(126, 55, image_Layer_9_bits,                             8,  8, GxEPD_BLACK);
    display.setCursor(60, 47);
    display.print("hi matthew");
    display.drawBitmap(63,  110, image_device_power_button_bits,               15, 16, GxEPD_BLACK);
    display.drawBitmap(227, 116, image_arrow_right_bits,                       14, 10, GxEPD_BLACK);
  } while (display.nextPage());
}

void drawScene1() {
  display.setFullWindow();
  display.firstPage();
  do {
    display.fillScreen(GxEPD_WHITE);
    display.drawBitmap(265, 4,  image_battery_empty_bits,  24, 16, GxEPD_BLACK);
    display.drawBitmap(7,   4,  image_bluetooth_bits,       14, 16, GxEPD_BLACK);
    display.setFont();
    display.setTextColor(GxEPD_BLACK);
    display.setCursor(133, 6);
    display.print("music");
    display.setCursor(33, 48);
    display.print("now playing:");
    display.setCursor(107, 70);
    display.print(songTitle);
    display.setCursor(107, 81);
    display.print(artistName);
    display.setCursor(107, 93);
    display.print(albumName);
    display.drawBitmap(227, 110, image_music_play_bits,     15, 16, GxEPD_BLACK);
    display.drawBitmap(227, 90,  image_music_next_bits,     16, 16, GxEPD_BLACK);
    display.drawBitmap(227, 70,  image_music_previous_bits, 16, 16, GxEPD_BLACK);
    display.drawBitmap(64,  116, image_arrow_left_bits,     14, 10, GxEPD_BLACK);
  } while (display.nextPage());
}

void setup() {
  pinMode(BUTTON_PIN, INPUT_PULLUP);

  display.init();
  display.setRotation(3);

  // BLE setup
  Bluefruit.begin();
  Bluefruit.setName("Tomogatchi");

  musicService.begin();

  titleChar.setProperties(CHR_PROPS_WRITE | CHR_PROPS_WRITE_WO_RESP);
  titleChar.setPermission(SECMODE_OPEN, SECMODE_OPEN);
  titleChar.setWriteCallback(titleWriteCallback);
  titleChar.begin();

  artistChar.setProperties(CHR_PROPS_WRITE | CHR_PROPS_WRITE_WO_RESP);
  artistChar.setPermission(SECMODE_OPEN, SECMODE_OPEN);
  artistChar.setWriteCallback(artistWriteCallback);
  artistChar.begin();

  albumChar.setProperties(CHR_PROPS_WRITE | CHR_PROPS_WRITE_WO_RESP);
  albumChar.setPermission(SECMODE_OPEN, SECMODE_OPEN);
  albumChar.setWriteCallback(albumWriteCallback);
  albumChar.begin();

  Bluefruit.Advertising.addFlags(BLE_GAP_ADV_FLAGS_LE_ONLY_GENERAL_DISC_MODE);
  Bluefruit.Advertising.addTxPower();
  Bluefruit.Advertising.addService(musicService);
  Bluefruit.Advertising.addName();
  Bluefruit.Advertising.start();

  drawScene0();
}

void loop() {
  bool buttonState = digitalRead(BUTTON_PIN);
  if (buttonState == LOW && lastButtonState == HIGH) {
    delay(50);
    currentScene = (currentScene + 1) % 2;
    if (currentScene == 0) drawScene0();
    else drawScene1();
  }
  lastButtonState = buttonState;

  // Redraw music scene if BLE updated song info
  if (musicUpdated && currentScene == 1) {
    musicUpdated = false;
    drawScene1();
  }
}